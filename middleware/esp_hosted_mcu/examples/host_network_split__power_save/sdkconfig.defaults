## middleware/esp_hosted_mcu/slave/main/Kconfig.projbuild
```kconfig
menu "Example Configuration"

	config ESP_HOSTED_COPROCESSOR
		bool
		default y

	menu "Bus Config in between Host and Co-processor"
		choice ESP_HOST_DEV_BOARD
			bool "Configure GPIOs based on an ESP Development Board"
			default ESP_HOST_DEV_BOARD_NONE
			help
				"Preconfigures GPIOs to use based on an ESP Development Board"

			config ESP_HOST_DEV_BOARD_NONE
				bool "No specific development board"

			config ESP_HOST_DEV_BOARD_P4_FUNC_BOARD
				bool "ESP32-P4-Function-EV-Board"
				depends on IDF_TARGET_ESP32C6

			config C2_C5_MODULE_SUB_BOARD
				bool "ESP32-P4 EV Sub-Board for C2 & C5"
				depends on IDF_TARGET_ESP32C2 || IDF_TARGET_ESP32C5
		endchoice

		choice ESP_HOST_INTERFACE
			bool "Transport layer"
			default ESP_SDIO_HOST_INTERFACE if SOC_SDIO_SLAVE_SUPPORTED
			default ESP_SPI_HOST_INTERFACE
			help
				Bus interface to be used for communication with the host

			config ESP_SPI_HOST_INTERFACE
				bool "SPI Full-duplex"
				help
					Enable/Disable SPI Full-duplex host interface

			config ESP_SDIO_HOST_INTERFACE
				bool "SDIO"
				depends on SOC_SDIO_SLAVE_SUPPORTED
				help
					Enable/Disable SDIO host interface

			# SPI Half Duplex is not supported in ESP32
			config ESP_SPI_HD_HOST_INTERFACE
				bool "SPI Half-duplex"
				depends on !IDF_TARGET_ESP32
				help
					Enable/Disable SPI Half-duplex host interface

			config ESP_UART_HOST_INTERFACE
				bool "UART"
				help
					Enable/Disable UART host interface
		endchoice

		menu "SPI Full-duplex Configuration"
			depends on ESP_SPI_HOST_INTERFACE
			depends on C2_C5_MODULE_SUB_BOARD || !C2_C5_MODULE_SUB_BOARD

			choice ESP_SPI_PRIV_MODE
				bool "Slave SPI mode"
				default ESP_SPI_PRIV_MODE_2 if IDF_TARGET_ESP32
				default ESP_SPI_PRIV_MODE_3

				config ESP_SPI_PRIV_MODE_0
					bool "Slave SPI mode 0"

				config ESP_SPI_PRIV_MODE_1
					bool "Slave SPI mode 1"

				config ESP_SPI_PRIV_MODE_2
					bool "Slave SPI mode 2"

				config ESP_SPI_PRIV_MODE_3
					bool "Slave SPI mode 3"
			endchoice

			config ESP_SPI_MODE
				int
				default 0 if ESP_SPI_PRIV_MODE_0
				default 1 if ESP_SPI_PRIV_MODE_1
				default 2 if ESP_SPI_PRIV_MODE_2
				default 3 if ESP_SPI_PRIV_MODE_3
				default 3


			choice SPI_CONTROLLER
				bool "SPI controller to use"
				default SPI_HSPI

				config SPI_HSPI
					bool "FSPI/HSPI"
					help
						"HSPI/FSPI: SPI_controller_1"

				config SPI_VSPI
					depends on IDF_TARGET_ESP32
					bool "VSPI"
					help
						"VSPI: SPI_controller_2"

			endchoice

			config ESP_SPI_CONTROLLER
				int
				default 2 if SPI_VSPI
				default 1

			menu "Hosted SPI GPIOs"
				config ESP_SPI_HSPI_GPIO_MOSI
					depends on SPI_HSPI
					int "Slave GPIO pin for Host MOSI"
					default 20 if ESP_HOST_DEV_BOARD_P4_FUNC_BOARD
					default 13 if IDF_TARGET_ESP32
					default 11 if IDF_TARGET_ESP32S2 || IDF_TARGET_ESP32S3
					default 7
					help
						SPI controller Host MOSI

				config ESP_SPI_HSPI_GPIO_MISO
					depends on SPI_HSPI
					int "Slave GPIO pin for Host MISO"
					default 21 if ESP_HOST_DEV_BOARD_P4_FUNC_BOARD
					default 12 if IDF_TARGET_ESP32
					default 13 if IDF_TARGET_ESP32S2 || IDF_TARGET_ESP32S3
					default 2
					help
						SPI controller Host MISO

				config ESP_SPI_HSPI_GPIO_CLK
					depends on SPI_HSPI
					int "Slave GPIO pin for Host CLK"
					default 19 if ESP_HOST_DEV_BOARD_P4_FUNC_BOARD
					default 3 if IDF_TARGET_ESP32C5
					default 0 if IDF_TARGET_ESP32C2 && C2_C5_MODULE_SUB_BOARD
					default 14 if IDF_TARGET_ESP32
					default 12 if IDF_TARGET_ESP32S2 || IDF_TARGET_ESP32S3
					default 6
					help
						SPI controller Host CLK

				config ESP_SPI_HSPI_GPIO_CS
					depends on SPI_HSPI
					int "Slave GPIO pin for Host  CS"
					default 18 if ESP_HOST_DEV_BOARD_P4_FUNC_BOARD
					default 15 if IDF_TARGET_ESP32
					default 10 if IDF_TARGET_ESP32S2 || IDF_TARGET_ESP32S3
					default 10
					help
						SPI controller Host CS

				config ESP_SPI_VSPI_GPIO_MOSI
					depends on SPI_VSPI
					int "Slave GPIO pin for Host MOSI"
					default 23
					help
						SPI controller Host MOSI

				config ESP_SPI_VSPI_GPIO_MISO
					depends on SPI_VSPI
					int "Slave GPIO pin for Host MISO"
					default 19
					help
						SPI controller Host MISO

				config ESP_SPI_VSPI_GPIO_CLK
					depends on SPI_VSPI
					int "Slave GPIO pin for Host CLK"
					default 18
					help
						SPI controller Host CLK

				config ESP_SPI_VSPI_GPIO_CS
					depends on SPI_VSPI
					int "Slave GPIO pin for Host CS"
					default 5
					help
						SPI controller Host CS

				config ESP_SPI_GPIO_MOSI
					int
					default ESP_SPI_VSPI_GPIO_MOSI if SPI_VSPI
					default ESP_SPI_HSPI_GPIO_MOSI

				config ESP_SPI_GPIO_MISO
					int
					default ESP_SPI_VSPI_GPIO_MISO if SPI_VSPI
					default ESP_SPI_HSPI_GPIO_MISO

				config ESP_SPI_GPIO_CLK
					int
					default ESP_SPI_VSPI_GPIO_CLK if SPI_VSPI
					default ESP_SPI_HSPI_GPIO_CLK

				config ESP_SPI_GPIO_CS
					int
					default ESP_SPI_VSPI_GPIO_CS if SPI_VSPI
					default ESP_SPI_HSPI_GPIO_CS

				config ESP_SPI_GPIO_HANDSHAKE
					int "Slave GPIO pin for handshake"
					default 22 if ESP_HOST_DEV_BOARD_P4_FUNC_BOARD
					default 18 if IDF_TARGET_ESP32C2 && C2_C5_MODULE_SUB_BOARD
					default 3 if IDF_TARGET_ESP32C2 && !C2_C5_MODULE_SUB_BOARD
					default 4 if IDF_TARGET_ESP32C5 && C2_C5_MODULE_SUB_BOARD
					default 1 if IDF_TARGET_ESP32C5 && !C2_C5_MODULE_SUB_BOARD
					default 3 if IDF_TARGET_ESP32C2 || IDF_TARGET_ESP32C3 || IDF_TARGET_ESP32C6
					default 17 if IDF_TARGET_ESP32S3 || IDF_TARGET_ESP32S2
					default 26
					help
						Slave GPIO pin to use for handshake with other spi controller

				config ESP_SPI_GPIO_DATA_READY
					int "Slave GPIO pin for data ready interrupt"
					default 23 if ESP_HOST_DEV_BOARD_P4_FUNC_BOARD
					default 1 if IDF_TARGET_ESP32C2 && C2_C5_MODULE_SUB_BOARD
					default 4 if IDF_TARGET_ESP32C2 && !C2_C5_MODULE_SUB_BOARD
					default 0 if IDF_TARGET_ESP32C5 && C2_C5_MODULE_SUB_BOARD
					default 4 if IDF_TARGET_ESP32C5 && !C2_C5_MODULE_SUB_BOARD
					default 4
					help
						Slave GPIO pin for indicating host that SPI slave has data to be read by host

				config ESP_SPI_GPIO_RESET
					int "Slave GPIO pin to reset itself"
					default -1
					help
						Host uses this pin to reset the slave ESP. To re-use ESP 'RST' or 'EN' GPIO, set value to -1
			endmenu

			config ESP_SPI_DEASSERT_HS_ON_CS
				bool "Deassert Handshake when SPI CS is deasserted"
				default y
				help
					Deassert Handshake and prepare a new SPI transaction only after
					CS has been deasserted. This helps prevent data loss with MCUs
					that delay deasserting CS after the end of a SPI transaction
					by prematurely starting a new slave SPI transaction
					since CS is detected by the slave as still asserted.

			config ESP_SPI_TX_Q_SIZE
				int "ESP to Host SPI queue size"
				default 10 if IDF_TARGET_ESP32
				default 6 if IDF_TARGET_ESP32C2 && BT_ENABLED
				default 10 if IDF_TARGET_ESP32C2
				default 20
				help
					Very small tx queue will lower ESP -- SPI --> Host data rate

			config ESP_SPI_RX_Q_SIZE
				int "Host to ESP SPI queue size"
				default 10 if IDF_TARGET_ESP32
				default 6 if IDF_TARGET_ESP32C2 && BT_ENABLED
				default 7 if IDF_TARGET_ESP32C2
				default 20
				help
					Very small RX queue will lower ESP <-- SPI -- Host data rate

			config ESP_SPI_CHECKSUM
				bool "SPI checksum ENABLE/DISABLE"
				default y
				help
					ENABLE/DISABLE software SPI checksum
		endmenu

		menu "SDIO Configuration"
			depends on ESP_SDIO_HOST_INTERFACE

			config ESP_SDIO_STREAMING_MODE
				bool "Enable SDIO Streaming Mode"
				default y
				help
					Enable Streaming Mode. Host to receive queued data from slave
					as one stream instead of individual packets. This can improve
					host SDIO read performance by doing one large read transaction
					instead of many smaller read transactions.

			config ESP_SDIO_GPIO_RESET
				int "Slave GPIO pin to reset itself"
				default -1
				help
					Host uses this pin to reset the slave ESP. To re-use ESP 'RST' or 'EN' GPIO, set value to -1

			choice
				prompt "SDIO Bus Speed"
				default ESP_SDIO_HIGH_SPEED
				help
					Select the SDIO Slave Bus Speed. Actual speed in use depends on SDIO bus speed the SDIO Master can support

				config ESP_SDIO_DEFAULT_SPEED
					bool "Default Speed (20 MHz)"

				config ESP_SDIO_HIGH_SPEED
					bool "High Speed (40 MHz)"
			endchoice

			# from <esp-idf>/components/soc/<soc>/include/soc/sdio_slave_pins.h
			menu "Hosted SDIO GPIOs"
				config ESP_SDIO_PIN_CMD
					int "CMD GPIO number"
					range 15 15 if IDF_TARGET_ESP32
					range 18 18 if IDF_TARGET_ESP32C6
					range 25 25 if IDF_TARGET_ESP32C61
					range 10 10 if IDF_TARGET_ESP32C5
					help
						"Value cannot be configured. Displayed for reference."

				config ESP_SDIO_PIN_CLK
					int "CLK GPIO number"
					range 14 14 if IDF_TARGET_ESP32
					range 19 19 if IDF_TARGET_ESP32C6
					range 26 26 if IDF_TARGET_ESP32C61
					range 9 9 if IDF_TARGET_ESP32C5
					help
						"Value cannot be configured. Displayed for reference."

				config ESP_SDIO_PIN_D0
					int "D0 GPIO number"
					range 2 2 if IDF_TARGET_ESP32
					range 20 20 if IDF_TARGET_ESP32C6
					range 27 27 if IDF_TARGET_ESP32C61
					range 8 8 if IDF_TARGET_ESP32C5
					help
						"Value cannot be configured. Displayed for reference."

				config ESP_SDIO_PIN_D1
					int "D1 GPIO number"
					range 4 4 if IDF_TARGET_ESP32
					range 21 21 if IDF_TARGET_ESP32C6
					range 28 28 if IDF_TARGET_ESP32C61
					range 7 7 if IDF_TARGET_ESP32C5
					help
						"Value cannot be configured. Displayed for reference."

				config ESP_SDIO_PIN_D2
					int "D2 GPIO number"
					range 12 12 if IDF_TARGET_ESP32
					range 22 22 if IDF_TARGET_ESP32C6
					range 22 22 if IDF_TARGET_ESP32C61
					range 14 14 if IDF_TARGET_ESP32C5
					help
						"Value cannot be configured. Displayed for reference."

				config ESP_SDIO_PIN_D3
					int "D3 GPIO number"
					range 13 13 if IDF_TARGET_ESP32
					range 23 23 if IDF_TARGET_ESP32C6
					range 23 23 if IDF_TARGET_ESP32C61
					range 13 13 if IDF_TARGET_ESP32C5
					help
						"Value cannot be configured. Displayed for reference."
			endmenu

			choice
				prompt "SDIO Slave Timing"
				default ESP_SDIO_PSEND_PSAMPLE
				help
					Select the SDIO timing used by slave. Default value works with most
					SDMMC controllers but if transfer errors are encountered, selecting a
					different timing may help resolve the errors.
					See https://docs.espressif.com/projects/esp-idf/en/latest/esp32/api-reference/peripherals/sdio_slave.html#_CPPv419sdio_slave_timing_t
					for more information

				config ESP_SDIO_PSEND_PSAMPLE
					bool "Send at positive edge, sample at positive edge"

				config ESP_SDIO_NSEND_PSAMPLE
					bool "Send at negative edge, sample at positive edge"

				config ESP_SDIO_PSEND_NSAMPLE
					bool "Send at positive edge, sample at negative edge"

				config ESP_SDIO_NSEND_NSAMPLE
					bool "Send at negative edge, sample at negative edge"
			endchoice

			config ESP_SDIO_TX_Q_SIZE
				int "SDIO TX queue size"
				default 10 if IDF_TARGET_ESP32C61
				default 20
				help
					Very small TX queue will lower ESP --> SDIO -- Host data rate

			config ESP_SDIO_RX_Q_SIZE
				int "SDIO RX queue size"
				default 10 if IDF_TARGET_ESP32C61
				default 20
				help
					Very small RX queue will lower ESP <-- SDIO -- Host data rate

			config ESP_SDIO_CHECKSUM
				bool "SDIO checksum ENABLE/DISABLE"
				default n
				help
					ENABLE/DISABLE software SDIO checksum

		endmenu

		menu "SPI Half-duplex Configuration"
			depends on ESP_SPI_HD_HOST_INTERFACE

			choice ESP_SPI_HD_PRIV_MODE
				bool "Slave SPI mode"
				default ESP_SPI_HD_PRIV_MODE_3

				config ESP_SPI_HD_PRIV_MODE_0
					bool "Slave SPI mode 0"

				config ESP_SPI_HD_PRIV_MODE_1
					bool "Slave SPI mode 1"

				config ESP_SPI_HD_PRIV_MODE_2
					bool "Slave SPI mode 2"

				config ESP_SPI_HD_PRIV_MODE_3
					bool "Slave SPI mode 3"
			endchoice

			config ESP_SPI_HD_MODE
				int
				default 0 if ESP_SPI_HD_PRIV_MODE_0
				default 1 if ESP_SPI_HD_PRIV_MODE_1
				default 2 if ESP_SPI_HD_PRIV_MODE_2
				default 3 if ESP_SPI_HD_PRIV_MODE_3
				help
					SPI Mode to use. The same mode must be used on both host and slave.

			choice ESP_SPI_HD_PRIV_INTERFACE_NUM_DATA_LINES
				bool "Num Data Lines to use"
				default ESP_SPI_HD_PRIV_INTERFACE_4_DATA_LINES
				help
					Number of Data Lines to use in the SPI HD interface

				config ESP_SPI_HD_PRIV_INTERFACE_4_DATA_LINES
					bool "4 data lines"

				config ESP_SPI_HD_PRIV_INTERFACE_2_DATA_LINES
					bool "2 data lines"
			endchoice

			config ESP_SPI_HD_INTERFACE_NUM_DATA_LINES
				int
				default 4 if ESP_SPI_HD_PRIV_INTERFACE_4_DATA_LINES
				default 2 if ESP_SPI_HD_PRIV_INTERFACE_2_DATA_LINES

			menu "GPIOs"

				config ESP_SPI_HD_GPIO_CS
					int "Slave GPIO pin for Host CS"
					default 18 if ESP_HOST_DEV_BOARD_P4_FUNC_BOARD
					default 10
					help
						SPI HD controller Host CS

				config ESP_SPI_HD_GPIO_CLK
					int "Slave GPIO pin for Host CLK"
					default 19 if ESP_HOST_DEV_BOARD_P4_FUNC_BOARD
					default 3 if IDF_TARGET_ESP32C5
					default 0 if IDF_TARGET_ESP32C2
					default 6
					help
						SPI HD controller Host CS

				config ESP_SPI_HD_GPIO_D0
					int "Slave GPIO pin for Host D0"
					default 20 if ESP_HOST_DEV_BOARD_P4_FUNC_BOARD
					default 7
					help
						SPI HD controller Host D0

				config ESP_SPI_HD_GPIO_D1
					int "Slave GPIO pin for Host D1"
					default 21 if ESP_HOST_DEV_BOARD_P4_FUNC_BOARD
					default 2
					help
						SPI HD controller Host D1

				config ESP_SPI_HD_GPIO_D2
					depends on ESP_SPI_HD_PRIV_INTERFACE_4_DATA_LINES
					int "Slave GPIO pin for Host D2"
					default 22 if ESP_HOST_DEV_BOARD_P4_FUNC_BOARD
					default 5
					help
						SPI HD controller Host D2

				config ESP_SPI_HD_GPIO_D3
					depends on ESP_SPI_HD_PRIV_INTERFACE_4_DATA_LINES
					int "Slave GPIO pin for Host D3"
					default 23 if ESP_HOST_DEV_BOARD_P4_FUNC_BOARD
					default 4
					help
						SPI HD controller Host D3

				config ESP_SPI_HD_GPIO_DATA_READY
					int "Slave GPIO pin for Data Ready"
					default 2 if ESP_HOST_DEV_BOARD_P4_FUNC_BOARD
					default 0 if IDF_TARGET_ESP32C5
					default 1 if IDF_TARGET_ESP32C2
					default 11
					help
						Slave GPIO pin for indicating host that SPI slave has data to be read by host

				choice ESP_SPI_HD_DATAREADY_GPIO_CONFIG
					bool "DataReady GPIO Config"
					default ESP_DR_ACTIVE_HIGH
					help
						Configure Data Ready to be active high (default) or active low

					config ESP_DR_ACTIVE_HIGH
						bool "Active High"
					config ESP_DR_ACTIVE_LOW
						bool "Active Low"
				endchoice

				config ESP_SPI_HD_GPIO_RESET
					int "Slave GPIO pin to reset itself"
					default -1
					help
						Host uses this pin to reset the slave ESP. To re-use ESP 'RST' or 'EN' GPIO, set value to -1

			endmenu

			config ESP_SPI_HD_Q_SIZE
				int "Queue size"
				default 12 if IDF_TARGET_ESP32C2
				default 10 if IDF_TARGET_ESP32C5
				default 20
				help
					Very small queue will lower SPI HD data rate

			config ESP_SPI_HD_CHECKSUM
				bool "Checksum ENABLE/DISABLE"
				default y
				help
					ENABLE/DISABLE SPI HD software checksum

		endmenu

		menu "UART Configuration"
			depends on ESP_UART_HOST_INTERFACE

			config ESP_UART_PORT
				int "UART Port to Use"
				default 1
				range 0 2 if IDF_TARGET_ESP32
				range 0 1 if IDF_TARGET_ESP32C2 || IDF_TARGET_ESP32C3 || IDF_TARGET_ESP32C5 || IDF_TARGET_ESP32C6
				range 0 2 if IDF_TARGET_ESP32C61
				range 0 1 if IDF_TARGET_ESP32S2
				range 0 2 if IDF_TARGET_ESP32S3
				help
					Select UART Port to Use. Do not select the UART Port used for console output (if enabled)

			config ESP_UART_PIN_TX
				int "TX GPIO number"
				default 13 if IDF_TARGET_ESP32
				default 5 if IDF_TARGET_ESP32C2 || IDF_TARGET_ESP32C3
				default 14 if IDF_TARGET_ESP32C5
				default 21 if IDF_TARGET_ESP32C6
				default 5 if IDF_TARGET_ESP32S2 || IDF_TARGET_ESP32S3
				help
					GPIO used for UART TX

			config ESP_UART_PIN_RX
				int "RX GPIO number"
				default 12 if IDF_TARGET_ESP32
				default 4 if IDF_TARGET_ESP32C2 || IDF_TARGET_ESP32C3
				default 13 if IDF_TARGET_ESP32C5
				default 20 if IDF_TARGET_ESP32C6
				default 4 if IDF_TARGET_ESP32S2 || IDF_TARGET_ESP32S3
				help
					GPIO used for UART RX

			config ESP_UART_BAUDRATE
				int "Baud Rate"
				default 921600
				range 9600 3500000
				help
					Baud Rate to Use. Make sure Hardware supports the rate. Standard rates are 9600, 19200, 38400, 57600, 115200, 460800, 921600

			config ESP_UART_NUM_DATA_BITS
				int "Number of Data Bits"
				default 8
				range 5 8
				help
					Number of Data Bits to use

			choice ESP_UART_PRIV_PARITY
				bool "Parity"

				config ESP_UART_PRIV_PARITY_NONE
					bool "None"

				config ESP_UART_PRIV_PARITY_EVEN
					bool "Even"

				config ESP_UART_PRIV_PARITY_ODD
					bool "Odd"
			endchoice

			config ESP_UART_PARITY
				int
				default 0 if ESP_UART_PRIV_PARITY_NONE
				default 1 if ESP_UART_PRIV_PARITY_EVEN
				default 2 if ESP_UART_PRIV_PARITY_ODD

			choice ESP_UART_PRIV_STOP_BITS
				bool "Number of Stop Bits"

				config ESP_UART_PRIV_STOP_BITS_1
					bool "1"

				config ESP_UART_PRIV_STOP_BITS_1_5
					bool "1.5"

				config ESP_UART_PRIV_STOP_BITS_2
					bool "2"
			endchoice

			config ESP_UART_STOP_BITS
				int
				default 0 if ESP_UART_PRIV_STOP_BITS_1
				default 1 if ESP_UART_PRIV_STOP_BITS_1_5
				default 2 if ESP_UART_PRIV_STOP_BITS_2

			config ESP_UART_GPIO_RESET
				int "Slave GPIO pin to reset itself"
				default -1
				help
					Host uses this pin to reset the slave ESP. To re-use ESP 'RST' or 'EN' GPIO, set value to -1

			config ESP_UART_TX_Q_SIZE
				int "Tx Queue Size"
				default 5
				help
					UART rates are low, so large queue sizes are not required

			config ESP_UART_RX_Q_SIZE
				int "Rx Queue Size"
				default 5
				help
					UART rates are low, so large queue sizes are not required

			config ESP_UART_CHECKSUM
				bool "UART checksum ENABLE/DISABLE"
				default y
				help
					ENABLE/DISABLE software UART checksum
		endmenu

		config ESP_GPIO_SLAVE_RESET
			int
			default ESP_SPI_GPIO_RESET if ESP_SPI_HOST_INTERFACE
			default ESP_SDIO_GPIO_RESET if ESP_SDIO_HOST_INTERFACE
			default ESP_SPI_HD_GPIO_RESET if ESP_SPI_HD_HOST_INTERFACE
			default ESP_UART_GPIO_RESET if ESP_UART_HOST_INTERFACE

	endmenu

	# HCI UART menu for ESP32-C3/S3
	menu "HCI UART Settings"
		depends on BT_CTRL_HCI_MODE_UART_H4 && (IDF_TARGET_ESP32C3 || IDF_TARGET_ESP32S3)

		# only S3 has two UART ports to select from
		config ESP_HOSTED_PRIV_BT_UART_PORT_ESP32_S3
			int "HCI UART Port"
			depends on IDF_TARGET_ESP32S3
			default 1
			range 1 2
			help
				UART Port for HCI

		config ESP_HOSTED_BT_UART_PORT_ESP32_C3_S3
			int
			default ESP_HOSTED_PRIV_BT_UART_PORT_ESP32_S3 if IDF_TARGET_ESP32S3
			default 1

		config ESP_HOSTED_BT_UART_BAUDRATE_ESP32_C3_S3
			int "HCI UART Baudrate"
			range 115200 921600
			default 921600
			help
				UART Baudrate for HCI. Please use standard baudrate.

		config ESP_HOSTED_BT_UART_TX_PIN_ESP32_C3_S3
			int "HCI UART Tx Pin"
			default 5 if IDF_TARGET_ESP32C3
			default 16
			help
				UART Tx Pin for HCI

		config ESP_HOSTED_BT_UART_RX_PIN_ESP32_C3_S3
			int "HCI UART Rx Pin"
			default 18
			help
				UART Rx Pin for HCI

		choice ESP_HOSTED_PRIV_BT_UART_FLOWCONTROL_ESP32_C3_S3
			bool "HCI UART Flow Control"
			default ESP_HOSTED_BT_UART_FLOWCONTROL_DISABLED

			config ESP_HOSTED_BT_UART_FLOWCONTROL_DISABLED
				bool "Disabled"

			config ESP_HOSTED_BT_UART_FLOWCONTROL_ENABLED
				bool "Enabled"
		endchoice

		config ESP_HOSTED_BT_UART_FLOWCONTROL_ESP32_C3_S3
			int
			default 3 if ESP_HOSTED_BT_UART_FLOWCONTROL_ENABLED
			default 0

		config ESP_HOSTED_BT_UART_RTS_PIN_ESP32_C3_S3
			depends on ESP_HOSTED_BT_UART_FLOWCONTROL_ENABLED
			int "HCI UART RTS Pin"
			default 19
			help
				UART RTS Pin for HCI

		config ESP_HOSTED_BT_UART_CTS_PIN_ESP32_C3_S3
			depends on ESP_HOSTED_BT_UART_FLOWCONTROL_ENABLED
			int "HCI UART CTS Pin"
			default 1 if IDF_TARGET_ESP32C3
			default 20
			help
				UART CTS Pin for HCI

	endmenu

	# HCI UART menu for ESP32
	menu "HCI UART Settings"
		depends on BTDM_CTRL_HCI_MODE_UART_H4 && IDF_TARGET_ESP32

		config ESP_HOSTED_BT_UART_TX_PIN_ESP32
			int "HCI UART Tx Pin"
			default 5
			help
				UART Tx Pin for HCI

		config ESP_HOSTED_BT_UART_RX_PIN_ESP32
			int "HCI UART Rx Pin"
			default 18
			help
				UART Rx Pin for HCI

		config ESP_HOSTED_BT_UART_RTS_PIN_ESP32
			depends on BTDM_CTRL_HCI_UART_FLOW_CTRL_EN
			int "HCI UART RTS Pin"
			default 19
			help
				UART RTS Pin for HCI

		config ESP_HOSTED_BT_UART_CTS_PIN_ESP32
			depends on BTDM_CTRL_HCI_UART_FLOW_CTRL_EN
			int "HCI UART CTS Pin"
			default 23
			help
				UART CTS Pin for HCI

		comment "HCI UART Settings from Bluetooth Component"
		comment "To change Port, Baud Rate, Flow Control, select Component config ---> Bluetooth ---> Controller Options ---> HCI Config"

		config ESP_HOSTED_BT_UART_PORT_ESP32
			int "HCI UART Port"
			range BTDM_CTRL_HCI_UART_NO BTDM_CTRL_HCI_UART_NO
			help
				UART Port for HCI

		config ESP_HOSTED_BT_UART_BAUDRATE_ESP32
			int "HCI UART Baudrate"
			range BTDM_CTRL_HCI_UART_BAUDRATE BTDM_CTRL_HCI_UART_BAUDRATE
			help
				UART Baudrate for HCI. Please use standard baudrate.

	endmenu

	# HCI UART menu for other ESP32 chips
	menu "HCI UART Settings"
		depends on BT_LE_HCI_INTERFACE_USE_UART && !IDF_TARGET_ESP32 && !IDF_TARGET_ESP32C3 && !IDF_TARGET_ESP32S3
		comment "HCI UART Settings from Bluetooth Component"
		comment "To change, select Component config ---> Bluetooth ---> Controller Options ---> HCI Config"

		config ESP_HOSTED_BT_UART_PORT
			int "HCI UART Port"
			range BT_LE_HCI_UART_PORT BT_LE_HCI_UART_PORT # kconfig ignore: multiple-definition
			help
				UART Port for HCI

		config ESP_HOSTED_BT_UART_TX_PIN
			int "HCI UART Tx Pin"
			range BT_LE_HCI_UART_TX_PIN BT_LE_HCI_UART_TX_PIN
			help
				UART Tx Pin for HCI

		config ESP_HOSTED_BT_UART_RX_PIN
			int "HCI UART Rx Pin"
			range BT_LE_HCI_UART_RX_PIN BT_LE_HCI_UART_RX_PIN
			help
				UART Rx Pin for HCI

		config ESP_HOSTED_BT_UART_RTS_PIN
			depends on BT_LE_HCI_UART_FLOWCTRL
			int "HCI UART RTS Pin"
			range BT_LE_HCI_UART_RTS_PIN BT_LE_HCI_UART_RTS_PIN
			help
				UART RTS Pin for HCI

		config ESP_HOSTED_BT_UART_CTS_PIN
			depends on BT_LE_HCI_UART_FLOWCTRL
			int "HCI UART CTS Pin"
			range BT_LE_HCI_UART_CTS_PIN BT_LE_HCI_UART_CTS_PIN
			help
				UART CTS Pin for HCI

		config ESP_HOSTED_BT_UART_BAUDRATE
			int "HCI UART Baudrate"
			range BT_LE_HCI_UART_BAUD BT_LE_HCI_UART_BAUD
			help
				UART Baudrate for HCI. Please use standard baudrate.

	endmenu

	config ESP_HOSTED_DEFAULT_TASK_STACK_SIZE
		int "ESP-Hosted task stack size"
		default 4096
		help
			Default task size of ESP-Hosted tasks

	config ESP_HOSTED_DEFAULT_TASK_PRIORITY
		int "ESP-Hosted task priority"
		default 22
		help
			Default task priority of ESP-Hosted tasks

	config ESP_CACHE_MALLOC
		bool "Enable Mempool"
		default y
		help
			Mempool will help to alloc buffer without going to heap for every memory allocation or free

	config ESP_OTA_WORKAROUND
		bool "OTA workaround - Add sleeps while OTA write"
		default y
		help
			Enable/disable sleeps while OTA operations

	config ESP_WIFI_DPP_SUPPORT
		bool "Enable Wi-Fi Easy Connect (DPP)"
		default n
		help
			Enable Wi-Fi Easy Connect (DPP) support

	menu "Hosted Debugging"
		config ESP_RAW_THROUGHPUT_TRANSPORT
			bool "RawTP: Transport level throughput debug test"
			default n
				help
					Find max transport performance which helps to assess stability of porting done

		config ESP_RAW_TP_ESP_TO_HOST_PKT_LEN
			depends on ESP_RAW_THROUGHPUT_TRANSPORT
			int "RawTP: ESP to Host packet size"
			range 1 1500
			default 1460

		config ESP_RAW_TP_REPORT_INTERVAL
			depends on ESP_RAW_THROUGHPUT_TRANSPORT
			int "RawTP: periodic duration to report stats accumulated"
			default 10

		config ESP_PKT_STATS
			bool "Transport level packet stats"
			default n
			help
				On comparing with slave packet stats helps to understand any packet loss at hosted

		config ESP_PKT_STATS_INTERVAL_SEC
			depends on ESP_PKT_STATS
			int "Packet stats reporting interval (sec)"
			default 30

		config ESP_HOSTED_FUNCTION_PROFILING
			bool "Enable function execution time profiling"
			default n
			help
				Enable this option to measure and report function execution times.
				This is useful for performance profiling and optimization.

		config ESP_HOSTED_FUNCTION_PROFILING_MAX_ENTRIES
			int "Maximum number of functions to profile"
			depends on ESP_HOSTED_FUNCTION_PROFILING
			default 10
			range 1 50
			help
				Maximum number of unique functions that can be profiled simultaneously.
				Each entry consumes memory, so keep this value reasonable based on
				available memory.
	endmenu

	config ESP_HOSTED_NETWORK_SPLIT_ENABLED
		bool "Enable Network Split: Shared IP address between host and slave"
		depends on !IDF_TARGET_ESP32C2 && !IDF_TARGET_ESP32C3
		default n
		help
			Enables the LWIP stack on the slave to process its own set of ports,
			alongside the host stack. Helps split network traffic and allows
			background tasks on the slave, even when the host is in low-power mode.

	menu "Network Split Configuration"
		depends on ESP_HOSTED_NETWORK_SPLIT_ENABLED

		choice
			prompt "Destination LWIP for unfiltered packet"
			default ESP_DEFAULT_LWIP_SLAVE
			help
				Packets having destination port within 'remote' port range are forwarded to host. Rest unfiltered packets, are to be sent to this LWIP. Please note:
				(1) These settings are only for IP packets, yet.
				(2) Extra filtering may be in effect to respond some packets locally by slave LWIP.

			config ESP_DEFAULT_LWIP_SLAVE
				bool "Send packet to slave LWIP"

			config ESP_DEFAULT_LWIP_HOST
				bool "Send packet to host LWIP"

			config ESP_DEFAULT_LWIP_BOTH
				bool "Send packet to both LWIPs"
		endchoice

		menu "Host Static Port Forwarding"

			config ESP_HOSTED_HOST_RESERVED_PORTS_CONFIGURED
				bool "Extra port forwarding to host (static)"
				default y
				help
					Enable static port forwarding to host for specific ports

			config ESP_HOSTED_HOST_RESERVED_TCP_SRC_PORTS
				depends on ESP_HOSTED_HOST_RESERVED_PORTS_CONFIGURED
				string "TCP source ports to forward to host (comma separated)"
				default "22,8554"
				help
					Comma separated list of TCP source ports that will be allowed from host (Max 10)

			config ESP_HOSTED_HOST_RESERVED_TCP_DEST_PORTS
				depends on ESP_HOSTED_HOST_RESERVED_PORTS_CONFIGURED
				string "TCP destination ports to forward to host (comma separated)"
				default "22,80,443,8080,8554"
				help
					Comma separated list of TCP destination ports that will be forwarded to host (Max 10)

			config ESP_HOSTED_HOST_RESERVED_UDP_SRC_PORTS
				depends on ESP_HOSTED_HOST_RESERVED_PORTS_CONFIGURED
				string "UDP source ports to allowed from host (comma separated)"
				default ""
				help
					Comma separated list of UDP source ports that will be forwarded to host (Max 10)

			config ESP_HOSTED_HOST_RESERVED_UDP_DEST_PORTS
				depends on ESP_HOSTED_HOST_RESERVED_PORTS_CONFIGURED
				string "UDP destination ports to forward to host (comma separated)"
				default "53,123"
				help
					Comma separated list of UDP destination ports that will be forwarded to host (Max 10)
		endmenu

		menu "Slave side (local) LWIP port range"
			config LWIP_TCP_LOCAL_PORT_RANGE_START
				int "Slave TCP start port"
				default 61440
				help
					Slave side TCP start port. Host defaults to 49152
					Slave range: 61440-65535
					Host range: 49152-61439

			config LWIP_TCP_LOCAL_PORT_RANGE_END
				int "Slave TCP end port"
				default 65535
				help
					Slave side TCP end port. Host defaults to 61439
					Slave range: 61440-65535
					Host range: 49152-61439

			config LWIP_UDP_LOCAL_PORT_RANGE_START
				int "Slave UDP start port"
				default 61440
				help
					Slave side UDP start port. Host defaults to 49152
					Slave range: 61440-65535
					Host range: 49152-61439

			config LWIP_UDP_LOCAL_PORT_RANGE_END
				int "Slave UDP end port"
				default 65535
				help
					Slave side UDP end port. Host defaults to 61439
					Slave range: 61440-65535
					Host range: 49152-61439
		endmenu

		menu "Host side (remote) LWIP port range"
			config LWIP_TCP_REMOTE_PORT_RANGE_START
				int "Host TCP start port"
				default 49152
				help
					Host side TCP start port. Slave defaults to 61440
					Slave range: 61440-65535
					Host range: 49152-61439

			config LWIP_TCP_REMOTE_PORT_RANGE_END
				int "Host TCP end port"
				default 61439
				help
					Host side TCP end port. Slave defaults to 65535
					Slave range: 61440-65535
					Host range: 49152-61439

			config LWIP_UDP_REMOTE_PORT_RANGE_START
				int "Host UDP start port"
				default 49152
				help
					Host side UDP start port. Slave defaults to 61440
					Slave range: 61440-65535
					Host range: 49152-61439

			config LWIP_UDP_REMOTE_PORT_RANGE_END
				int "Host UDP end port"
				default 61439
				help
					Host side UDP end port. Slave defaults to 65535
					Slave range: 61440-65535
					Host range: 49152-61439
		endmenu

	endmenu

	config ESP_HOSTED_HOST_POWER_SAVE_ENABLED
		bool "Allow host to power save"
		default n
		help
			Allow host to enter power save mode.
			Host will notify slave before entering and exiting the power save

	menu "Host power save config"
		depends on ESP_HOSTED_HOST_POWER_SAVE_ENABLED

		config ESP_HOSTED_HOST_DEEP_SLEEP_ALLOWED
		depends on ESP_HOSTED_HOST_POWER_SAVE_ENABLED
			bool "Allow host to enter deep sleep. Slave will wakeup host using GPIO when needed"
			default y if ESP_HOSTED_HOST_POWER_SAVE_ENABLED
			select ESP_HOSTED_CLI_ENABLED
			help
				Allow host to enter deep sleep mode. Host will notify slave before entering deep sleep.

		menu "Host deep sleep - wakeup config"
			depends on ESP_HOSTED_HOST_DEEP_SLEEP_ALLOWED
			config ESP_HOSTED_HOST_WAKEUP_GPIO
				int "Slave out: Host wakeup GPIO"
				default 2 if IDF_TARGET_ESP32C6 && !ESP_SPI_HD_HOST_INTERFACE
				default 9 if IDF_TARGET_ESP32C6 && ESP_SPI_HD_HOST_INTERFACE
				default 1 if IDF_TARGET_ESP32C3
				default 25 if IDF_TARGET_ESP32C5
				default 6 if IDF_TARGET_ESP32C2 && C2_C5_MODULE_SUB_BOARD
				default -1

			choice ESP_HOSTED_HOST_WAKEUP_GPIO_LEVEL
				prompt "Host Wakeup GPIO Level"
				default ESP_HOSTED_HOST_WAKEUP_GPIO_LEVEL_HIGH

				config ESP_HOSTED_HOST_WAKEUP_GPIO_LEVEL_HIGH
					bool "High"
				config ESP_HOSTED_HOST_WAKEUP_GPIO_LEVEL_LOW
					bool "Low"
			endchoice

			config ESP_HOSTED_HOST_WAKEUP_GPIO_LEVEL
				int
				default 1 if ESP_HOSTED_HOST_WAKEUP_GPIO_LEVEL_HIGH
				default 0 if ESP_HOSTED_HOST_WAKEUP_GPIO_LEVEL_LOW
				help
					GPIO level to use for host wakeup from sleep.
					Set to 0 to use low level, set to 1 to use high level.
		endmenu

		config ESP_HOSTED_UNLOAD_BUS_DRIVER_DURING_HOST_SLEEP
			depends on ESP_HOSTED_HOST_POWER_SAVE_ENABLED
			bool "Unload low level BUS driver during host deep sleep"
			default n

		config PRINT_HOST_WAKEUP_PACKET_FULL_PKT
			bool "Print the full wakeup packet"
			default n

	endmenu


	config ESP_HOSTED_CLI_ENABLED
		bool "Enable CLI Shell"
		default y if ESP_HOSTED_HOST_DEEP_SLEEP_ALLOWED
		default n if !ESP_HOSTED_HOST_DEEP_SLEEP_ALLOWED
		help
			Enable CLI shell for debugging and control purposes.

	config ESP_HOSTED_CLI_NEW_INSTANCE
		depends on ESP_HOSTED_CLI_ENABLED
		bool "Create new instance & do not re-use existing session if any"
		default y

	config ESP_HOSTED_USE_EXAMPLE_WIFI_PRE_PROVISION_CONFIG
		bool "Wi-Fi default config (pre-provisioning)"
		default n
		help
			Enable this option to use a predefined Wi-Fi configuration for examples.
			This can be useful for testing and development purposes where a known
			Wi-Fi setup is required.


	menu "Wi-Fi default config (pre-provisioning)"
		depends on ESP_HOSTED_USE_EXAMPLE_WIFI_PRE_PROVISION_CONFIG

		config ESP_WIFI_SSID
			string "WiFi SSID"
			default "myssid"
			help
				SSID (network name) for the example to connect to.

		config ESP_WIFI_PASSWORD
			string "WiFi Password"
			default "mypassword"
			help
				WiFi password (WPA or WPA2) for the example to use.

		choice ESP_WIFI_SAE_MODE
			prompt "WPA3 SAE mode selection"
			default ESP_WPA3_SAE_PWE_BOTH
			help
				Select mode for SAE as Hunt and Peck, H2E or both.
			config ESP_WPA3_SAE_PWE_HUNT_AND_PECK
				bool "HUNT AND PECK"
			config ESP_WPA3_SAE_PWE_HASH_TO_ELEMENT
				bool "H2E"
			config ESP_WPA3_SAE_PWE_BOTH
				bool "BOTH"
		endchoice

		config ESP_WIFI_PW_ID
			string "PASSWORD IDENTIFIER"
			depends on ESP_WPA3_SAE_PWE_HASH_TO_ELEMENT|| ESP_WPA3_SAE_PWE_BOTH
			default ""
			help
				password identifier for SAE H2E

		config ESP_MAXIMUM_RETRY
			int "Maximum retry"
			default 5
			help
			Set the Maximum retry to avoid station reconnecting to the AP unlimited when the AP is really inexistent.

		choice ESP_WIFI_SCAN_AUTH_MODE_THRESHOLD
			prompt "WiFi Scan auth mode threshold"
			default ESP_WIFI_AUTH_WPA2_PSK
			help
				The weakest authmode to accept in the scan mode.
				This value defaults to ESP_WIFI_AUTH_WPA2_PSK incase password is present and ESP_WIFI_AUTH_OPEN is used.
				Please select ESP_WIFI_AUTH_WEP/ESP_WIFI_AUTH_WPA_PSK incase AP is operating in WEP/WPA mode.

			config ESP_WIFI_AUTH_OPEN
				bool "OPEN"
			config ESP_WIFI_AUTH_WEP
				bool "WEP"
			config ESP_WIFI_AUTH_WPA_PSK
				bool "WPA PSK"
			config ESP_WIFI_AUTH_WPA2_PSK
				bool "WPA2 PSK"
			config ESP_WIFI_AUTH_WPA_WPA2_PSK
				bool "WPA/WPA2 PSK"
			config ESP_WIFI_AUTH_WPA3_PSK
				bool "WPA3 PSK"
			config ESP_WIFI_AUTH_WPA2_WPA3_PSK
				bool "WPA2/WPA3 PSK"
			config ESP_WIFI_AUTH_WAPI_PSK
				bool "WAPI PSK"

		endchoice

		choice WIFI_CMD_DEFAULT_COUNTRY
			prompt "Set default country during initialize wifi"
			default WIFI_CMD_DEFAULT_COUNTRY_CN
			help
				Set default wifi country during initialize wifi

		config WIFI_CMD_DEFAULT_COUNTRY_NONE
			bool
			prompt "Do not set country code"

		config WIFI_CMD_DEFAULT_COUNTRY_CN
			bool
			prompt "Set country code to CN (1-13)"
		endchoice
	endmenu

	config ESP_HOSTED_EXTRA_EXAMPLES
		depends on ESP_HOSTED_NETWORK_SPLIT_ENABLED
		bool "Additional higher layer examples to run"
		default n
		help
			Extra set of optional examples to run at slave

	menu "Select Examples to run"
		depends on ESP_HOSTED_EXTRA_EXAMPLES

		config ESP_HOSTED_COPROCESSOR_EXAMPLE_MQTT
			bool "MQTT client example"
			default y

		menu "MQTT client config"
			depends on ESP_HOSTED_COPROCESSOR_EXAMPLE_MQTT
			choice BROKER_CHOICE
				prompt "MQTT Broker"
				default BROKER_HIVEMQ

				config BROKER_ECLIPSEPROJECTS
					bool "mqtt.eclipseprojects.io"
				config BROKER_HIVEMQ
					bool "broker.hivemq.com"
			endchoice

			config BROKER_URL
				string
				default "mqtt://mqtt.eclipseprojects.io" if BROKER_ECLIPSEPROJECTS
				default "mqtt://broker.hivemq.com" if BROKER_HIVEMQ
				help
					URL of the broker to connect to

			config BROKER_URL_FROM_STDIN
				bool
				default y if BROKER_URL = "FROM_STDIN"

		endmenu

		config ESP_HOSTED_COPROCESSOR_EXAMPLE_HTTP_CLIENT
			bool "HTTP client example"
			default y

		menu "HTTP client config"
			depends on ESP_HOSTED_COPROCESSOR_EXAMPLE_HTTP_CLIENT

			config HTTP_WEBSERVER
				string "HTTP webserver to send req"
				default "example.com"

			config HTTP_WEBSERVER_PORT
				string "HTTP webserver port"
				default "80"

			config HTTP_WEBSERVER_PATH
				string "HTTP webserver path"
				default "/"

			config HTTP_REQ_DELAY
				int "Delay after every http request (seconds)"
				default 10

		endmenu
	endmenu
endmenu
```
