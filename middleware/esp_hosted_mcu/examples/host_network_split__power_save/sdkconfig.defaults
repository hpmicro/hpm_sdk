## middleware/esp_hosted_mcu/examples/host_network_split__power_save/sdkconfig.defaults
```kconfig
CONFIG_ESP_SYSTEM_EVENT_TASK_STACK_SIZE=4096

CONFIG_FREERTOS_UNICORE=n
CONFIG_FREERTOS_HZ=1000

CONFIG_ESP_INT_WDT=n
CONFIG_ESP_TASK_WDT_EN=n

CONFIG_LWIP_IRAM_OPTIMIZATION=y
CONFIG_LWIP_TCPIP_TASK_PRIO=23

CONFIG_IPERF_TRAFFIC_TASK_PRIORITY=23
CONFIG_IPERF_REPORT_TASK_PRIORITY=24
CONFIG_COMPILER_OPTIMIZATION_PERF=y

CONFIG_PARTITION_TABLE_SINGLE_APP_LARGE=y

# Enable Network Split
CONFIG_ESP_HOSTED_NETWORK_SPLIT_ENABLED=y

#Enable Host power save
CONFIG_ESP_HOSTED_HOST_POWER_SAVE_ENABLED=y
CONFIG_ESP_HOSTED_HOST_DEEP_SLEEP_ALLOWED=y
#CONFIG_ESP_HOSTED_HOST_WAKEUP_GPIO=6
```

## middleware/esp_hosted_mcu/examples/host_transport_config/sdkconfig.defaults
```kconfig
# ESP-Hosted Configuration
CONFIG_ESP_HOSTED_ENABLED=y

# Transport Interface - Choose one based on your setup
# Uncomment the transport you want to use:

# SDIO Interface (default for this example)
CONFIG_ESP_HOSTED_SDIO_HOST_INTERFACE=y
CONFIG_ESP_HOSTED_SDIO_CLOCK_FREQ_KHZ=25000
CONFIG_ESP_HOSTED_SDIO_BUS_WIDTH=4
CONFIG_ESP_HOSTED_SDIO_TX_Q_SIZE=10
CONFIG_ESP_HOSTED_SDIO_RX_Q_SIZE=10

# SPI Interface (uncomment to use instead of SDIO)
# CONFIG_ESP_HOSTED_SPI_HOST_INTERFACE=y
# CONFIG_ESP_HOSTED_SPI_CLK_FREQ=10
# CONFIG_ESP_HOSTED_SPI_MODE=0
# CONFIG_ESP_HOSTED_SPI_TX_Q_SIZE=10
# CONFIG_ESP_HOSTED_SPI_RX_Q_SIZE=10

# SPI Half-Duplex Interface (uncomment to use instead of SDIO)
# CONFIG_ESP_HOSTED_SPI_HD_HOST_INTERFACE=y
# CONFIG_ESP_HOSTED_SPI_HD_CLK_FREQ=20
# CONFIG_ESP_HOSTED_SPI_HD_INTERFACE_NUM_DATA_LINES=4
# CONFIG_ESP_HOSTED_SPI_HD_TX_Q_SIZE=10
# CONFIG_ESP_HOSTED_SPI_HD_RX_Q_SIZE=10

# UART Interface (uncomment to use instead of SDIO)
# CONFIG_ESP_HOSTED_UART_HOST_INTERFACE=y
# CONFIG_ESP_HOSTED_UART_BAUDRATE=921600
# CONFIG_ESP_HOSTED_UART_TX_Q_SIZE=50
# CONFIG_ESP_HOSTED_UART_RX_Q_SIZE=50

# GPIO Configuration (adjust based on your board)
CONFIG_ESP_HOSTED_GPIO_SLAVE_RESET_SLAVE=21

# Console Configuration
CONFIG_ESP_CONSOLE_UART_DEFAULT=y
CONFIG_ESP_CONSOLE_UART_BAUDRATE_115200=y

# Logging
CONFIG_LOG_DEFAULT_LEVEL_INFO=y
CONFIG_LOG_MAXIMUM_LEVEL_VERBOSE=y

# FreeRTOS
CONFIG_FREERTOS_HZ=1000

# WiFi Configuration
CONFIG_ESP_WIFI_ENABLED=y

# Bluetooth Configuration (optional)
CONFIG_BT_ENABLED=y
CONFIG_BT_BLUEDROID_ENABLED=y
```

## middleware/esp_hosted_mcu/examples/host_wifi_easy_connect_dpp_enrollee/sdkconfig.defaults
```kconfig
CONFIG_FREERTOS_HZ=1000

### don't use any saved Wi-Fi config on the co-processor
CONFIG_WIFI_RMT_NVS_ENABLED=n

### enable DPP feature
CONFIG_ESP_HOSTED_ENABLE_DPP=y
```
