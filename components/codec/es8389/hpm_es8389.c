/*
 * Copyright (c) 2026 HPMicro
 *
 * SPDX-License-Identifier: BSD-3-Clause
 *
 */

#include "hpm_es8389.h"
#include "board.h"

struct _coeff_div { /* NOLINT */
    uint16_t ratio;
    uint32_t mclk;
    uint32_t lrclk;
    uint8_t reg0x04;
    uint8_t reg0x05;
    uint8_t reg0x06;
    uint8_t reg0x07;
    uint8_t reg0x08;
    uint8_t reg0x09;
    uint8_t reg0x0a;
    uint8_t reg0x0f;
    uint8_t reg0x11;
    uint8_t reg0x21;
    uint8_t reg0x22;
    uint8_t reg0x26;
    uint8_t reg0x30;
    uint8_t reg0x41;
    uint8_t reg0x42;
    uint8_t reg0x43;
    uint8_t reg0xf0;
    uint8_t reg0xf1;
    uint8_t reg0x16;
    uint8_t reg0x18;
    uint8_t reg0x19;
};

static const struct _coeff_div coeff_div[] = {
    /* ratio mclk  LRCK,reg0x04,reg0x05,reg0x06,reg0x07,reg0x08,reg0x09,reg0x0a,reg0x0f,reg0x11,reg0x21,reg0x22,reg0x26,reg0x30,reg0x41,reg0x42,reg0x43,reg0xf0,reg0xf1,reg0x16,reg0x18,reg0x19 */
    { 32, 256000, 8000, 0x00, 0x57, 0x84, 0xD0, 0x03, 0xC1, 0xB0, 0x00, 0x00, 0x1F, 0x7F, 0xBF, 0xC0, 0xFF, 0x7F, 0x01, 0x12, 0x00, 0x09, 0x19, 0x07 },
    { 36, 288000, 8000, 0x00, 0x55, 0x84, 0xD0, 0x01, 0xC1, 0x90, 0x00, 0x00, 0x23, 0x8F, 0xB7, 0xC0, 0x1F, 0x8F, 0x01, 0x12, 0x00, 0x09, 0x19, 0x07 },
    { 48, 384000, 8000, 0x02, 0x5F, 0x04, 0xC0, 0x03, 0xC1, 0xB0, 0x00, 0x00, 0x1F, 0x7F, 0xBF, 0xC0, 0xFF, 0x7F, 0x01, 0x12, 0x00, 0x09, 0x19, 0x07 },
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    { 128, 24576000, 192000, 0x00, 0x50, 0x00, 0xC0, 0x18, 0xC1, 0x81, 0xC0, 0x00, 0x8F, 0x7F, 0xEF, 0xC0, 0x3F, 0x7F, 0x80, 0x12, 0xC0, 0x3F, 0xF9, 0x3F },
#if ES8389_MicTypeSel == EVEREST_AMIC_SEL
    { 50, 400000, 8000, 0x00, 0x75, 0x05, 0xC8, 0x01, 0xC1, 0x90, 0x10, 0x00, 0x18, 0xC7, 0xD0, 0xC0, 0x8F, 0xC7, 0x01, 0x12, 0x00, 0x09, 0x19, 0x07 },
    { 600, 4800000, 8000, 0x05, 0x65, 0x25, 0xF9, 0x00, 0xD1, 0x90, 0x10, 0x00, 0x18, 0xC7, 0xD0, 0xC0, 0x8F, 0xC7, 0x01, 0x12, 0x00, 0x09, 0x19, 0x07 },
    { 1500, 12000000, 8000, 0x0E, 0x25, 0x25, 0xE8, 0x00, 0xD1, 0x90, 0x40, 0x00, 0x31, 0xC7, 0xC5, 0x00, 0x8F, 0xC7, 0x01, 0x12, 0x00, 0x09, 0x19, 0x07 },
    { 2400, 19200000, 8000, 0x0B, 0x01, 0x00, 0xD0, 0x00, 0xD1, 0x80, 0x90, 0x00, 0x31, 0xC7, 0xC5, 0x00, 0xC7, 0xC7, 0x00, 0x12, 0x00, 0x09, 0x19, 0x07 },
    { 3000, 24000000, 8000, 0x0E, 0x24, 0x05, 0xD0, 0x00, 0xC2, 0x80, 0xC0, 0x00, 0x31, 0xC7, 0xC5, 0x00, 0x8F, 0xC7, 0x01, 0x12, 0x00, 0x09, 0x19, 0x07 },
    { 3250, 26000000, 8000, 0x40, 0x05, 0xA4, 0xC0, 0x00, 0xD1, 0x80, 0xD0, 0x00, 0x31, 0xC7, 0xC5, 0x00, 0xC7, 0xC7, 0x00, 0x12, 0x00, 0x09, 0x19, 0x07 },
#else
    { 50, 400000, 8000, 0x00, 0x15, 0x85, 0xD0, 0x01, 0xC1, 0x90, 0x00, 0x00, 0x31, 0xC7, 0xC5, 0x00, 0x8F, 0xC7, 0x01, 0x12, 0x00, 0x09, 0x19, 0x07 },
    { 600, 4800000, 8000, 0x02, 0x24, 0x05, 0xD0, 0x00, 0xC2, 0x80, 0x00, 0x00, 0x31, 0xC7, 0xC5, 0x00, 0x8F, 0xC7, 0x01, 0x12, 0x00, 0x09, 0x19, 0x07 },
    { 1500, 12000000, 8000, 0x0E, 0x25, 0x25, 0xE8, 0x00, 0xD1, 0x90, 0x40, 0x00, 0x31, 0xC7, 0xC5, 0x00, 0x8F, 0xC7, 0x01, 0x12, 0x00, 0x09, 0x19, 0x07 },
    { 2400, 19200000, 8000, 0x05, 0x14, 0x01, 0xC9, 0x00, 0xD2, 0x80, 0x80, 0x00, 0x31, 0xC7, 0xC5, 0x00, 0x8F, 0xC7, 0x01, 0x12, 0x00, 0x09, 0x19, 0x07 },
    { 3000, 24000000, 8000, 0x0E, 0x24, 0x05, 0xD0, 0x00, 0xC2, 0x80, 0xC0, 0x00, 0x31, 0xC7, 0xC5, 0x00, 0x8F, 0xC7, 0x01, 0x12, 0x00, 0x09, 0x19, 0x07 },
    { 3250, 26000000, 8000, 0x40, 0x15, 0x85, 0xD0, 0x01, 0xC1, 0x90, 0xC0, 0x00, 0x31, 0xC7, 0xC5, 0x00, 0x8F, 0xC7, 0x01, 0x12, 0x00, 0x09, 0x19, 0x07 },
#endif
};

static inline int8_t get_coeff(uint32_t mclk, uint32_t rate, uint8_t array_size, const struct _coeff_div *coeff_div)
{
    int8_t i;
    for (i = 0; i < array_size; i++) {
        if ((coeff_div[i].ratio == rate) && (coeff_div[i].mclk == mclk)) {
            return i;
        }
    }
    return -1;
}

static hpm_stat_t es8389_write_reg(codec_control_t *control, uint8_t reg, uint8_t val)
{
    return i2c_master_address_write(control->ptr, control->slave_address, &reg, 1U, &val, 1U);
}

static hpm_stat_t es8389_read_reg(codec_control_t *control, uint8_t reg, uint8_t *val)
{
    return i2c_master_address_read(control->ptr, control->slave_address, &reg, 1U, val, 1U);
}

static hpm_stat_t es8389_modify_reg(codec_control_t *control, uint8_t reg, uint8_t clear_mask, uint8_t val)
{
    hpm_stat_t status;
    uint8_t reg_val;

    status = es8389_read_reg(control, reg, &reg_val);
    if (status != status_success) {
        return status;
    }

    reg_val = (reg_val & ~clear_mask) | (val & clear_mask);
    return es8389_write_reg(control, reg, reg_val);
}

void es8389_get_default_config(es8389_config_t *config)
{
    assert(config != NULL);

    /* Initializes the configure structure to zero. */
    memset(config, 0, sizeof(*config));

    config->master_mode = false;
    config->mclk_hz = 0U;
    config->sample_rate = 48000U;
    config->data_width = 32U;
    config->protocol = es8389_protocol_left_justified;
    config->lrclk_polarity = es8389_lrclk_polarity_low_for_left_channel;
}

hpm_stat_t es8389_init(codec_control_t *control, es8389_config_t *config)
{
    assert(control != NULL);
    assert(config != NULL);
    hpm_stat_t stat = status_success;

    uint32_t ratio = (int)((float)(config->mclk_hz) / (config->sample_rate) + 0.5f);

    int8_t coeff = get_coeff(config->mclk_hz, ratio, sizeof(coeff_div) / sizeof(struct _coeff_div), coeff_div);
    if (coeff < 0) {
        return status_invalid_argument;
    }

    HPM_CHECK_RET(es8389_write_reg(control, ES8389_REG0xF3_ISOLATION_CONTROL, 0x00));
    HPM_CHECK_RET(es8389_write_reg(control, ES8389_REG0x00_RESET_CONTROL, 0x7E));
    HPM_CHECK_RET(es8389_write_reg(control, ES8389_REG0xF3_ISOLATION_CONTROL, 0x38));
    HPM_CHECK_RET(es8389_write_reg(control, ES8389_REG0x24_ADC_HPF_CONTROL_1, 0x64));
    HPM_CHECK_RET(es8389_write_reg(control, ES8389_REG0x25_ADC_HPF_CONTROL_2, 0x04 + (ES8389_ADC1_Invert << 6) + (ES8389_ADC2_Invert << 5)));
    HPM_CHECK_RET(es8389_write_reg(control, ES8389_REG0x45_DAC_MISC_CONTROL_2, 0x03 + (ES8389_DAC1_Invert << 6) + (ES8389_DAC2_Invert << 5)));
    HPM_CHECK_RET(es8389_write_reg(control, ES8389_REG0x60_VMID_CONTROL, 0x2A));
    HPM_CHECK_RET(es8389_write_reg(control, ES8389_REG0x61_ANALOG_ENABLE_CONTROL_1, 0xC9));
    HPM_CHECK_RET(es8389_write_reg(control, ES8389_REG0x62_ANALOG_SYSTEM_CONTROL1, 0x4F));
    HPM_CHECK_RET(es8389_write_reg(control, ES8389_REG0x63_ANALOG_SYSTEM_CONTROL2, 0x06));
    HPM_CHECK_RET(es8389_write_reg(control, ES8389_REG0x6B_ANALOG_LOW_POWER_CONTROL_1, 0x00));
    HPM_CHECK_RET(es8389_write_reg(control, ES8389_REG0x6D_ADC_ANALOG_CONTROL1, 0x16 + (ES8389_DMICSel & 0xC0)));
    HPM_CHECK_RET(es8389_write_reg(control, ES8389_REG0x6E_PGA1_ANALOG_CONTROL, 0xAA));
    HPM_CHECK_RET(es8389_write_reg(control, ES8389_REG0x6F_ADC_ANALOG_CONTROL2, 0x66));
    HPM_CHECK_RET(es8389_write_reg(control, ES8389_REG0x70_ADC_ANALOG_CONTROL3, 0x99));

    if (ES8389_Analog_DriveSel == EVEREST_DRIVE_SEL_LOW_POWER) {
        HPM_CHECK_RET(es8389_write_reg(control, ES8389_REG0x6B_ANALOG_LOW_POWER_CONTROL_1, 0x80));
        HPM_CHECK_RET(es8389_write_reg(control, ES8389_REG0x6C_ANALOG_LOW_POWER_CONTROL_2, 0x0F));
        HPM_CHECK_RET(es8389_write_reg(control, ES8389_REG0x70_ADC_ANALOG_CONTROL3, 0x66));
    }

    HPM_CHECK_RET(es8389_write_reg(control, ES8389_REG0x23_ADC_MODE_CONTROL, 0x00 + (ES8389_DMIC_Invert << 2) + (ES8389_DMICSel & 0x03)));
    HPM_CHECK_RET(es8389_write_reg(control, ES8389_REG0x72_PGA1_GAIN_CONTROL, (ES8389_ADCL_InputSel << 4) + ES8389_ADC1_PGAGainSel));
    HPM_CHECK_RET(es8389_write_reg(control, ES8389_REG0x73_PGA2_GAIN_CONTROL, (ES8389_ADCR_InputSel << 4) + ES8389_ADC2_PGAGainSel));
    HPM_CHECK_RET(es8389_write_reg(control, ES8389_REG0x10_CSM_JUMP_CONTROL, 0xC4));
    /* Set master/slave mode */
    HPM_CHECK_RET(es8389_write_reg(control, ES8389_REG0x01_MISC_CONTROL,
                                   0x08 + (ES8389_BCLK_TRI << 7) + (ES8389_LRCK_TRI << 6) + (ES8389_ASDOUT_TRI << 5) + (config->master_mode)));
    HPM_CHECK_RET(es8389_write_reg(control, ES8389_REG0xF1_CSM_STATE_REPORT, 0x00));
    HPM_CHECK_RET(es8389_write_reg(control, EVEREST_REG0x12, 0x01));
    HPM_CHECK_RET(es8389_write_reg(control, EVEREST_REG0x13, 0x01));
    HPM_CHECK_RET(es8389_write_reg(control, EVEREST_REG0x14, 0x01));
    HPM_CHECK_RET(es8389_write_reg(control, EVEREST_REG0x15, 0x01));
    HPM_CHECK_RET(es8389_write_reg(control, EVEREST_REG0x16, 0x35));
    HPM_CHECK_RET(es8389_write_reg(control, EVEREST_REG0x17, 0x09));
    HPM_CHECK_RET(es8389_write_reg(control, EVEREST_REG0x18, 0x91));
    HPM_CHECK_RET(es8389_write_reg(control, EVEREST_REG0x19, 0x28));
    HPM_CHECK_RET(es8389_write_reg(control, EVEREST_REG0x1A, 0x01));
    HPM_CHECK_RET(es8389_write_reg(control, EVEREST_REG0x1B, 0x01));
    HPM_CHECK_RET(es8389_write_reg(control, EVEREST_REG0x1C, 0x11));
    HPM_CHECK_RET(es8389_write_reg(control, ES8389_REG0x2A_ADC_PTDM_CONTROL, 0x00 + (ES8389_ADCPTDM_SLOTSel << 4)));

    HPM_CHECK_RET(es8389_write_reg(control, ES8389_REG0x20_ADC_SP_CONTROL, 0x00 + (ES8389_ADC1_MUTE << 1) + (ES8389_ADC2_MUTE << 0)));
    HPM_CHECK_RET(es8389_write_reg(control, ES8389_REG0x40_DAC_SERIAL_PORT_CONTROL, 0x00 + (ES8389_DAC1_MUTE << 1) + (ES8389_DAC2_MUTE << 0)));
    HPM_CHECK_RET(es8389_set_protocol(control, config->protocol, config->lrclk_polarity));

    HPM_CHECK_RET(es8389_write_reg(control, ES8389_REG0xF0_CHIP_MISC_CONTROL, 0x12 + (ES8389_LOOP_DACToADC << 3) + (ES8389_LOOP_ADCToDAC << 2)));
    HPM_CHECK_RET(es8389_write_reg(control, ES8389_REG0x02_MASTER_CLOCK_CONTROL,
                                   0x00 + (ES8389_MainCLK_Source << 6) + (ES8389_MCLK_Invert << 1) + (ES8389_BCLK_Invert << 0)));
    HPM_CHECK_RET(es8389_write_reg(control, ES8389_REG0x04_MAIN_CLOCK_DIVIDER1, 0x00));
    HPM_CHECK_RET(es8389_write_reg(control, ES8389_REG0x05_MASTER_CLOCK_MULTIPLICATION, 0x10));
    HPM_CHECK_RET(es8389_write_reg(control, ES8389_REG0x06_MAIN_CLOCK_MUX1, 0x00));
    HPM_CHECK_RET(es8389_write_reg(control, ES8389_REG0x07_MAIN_CLOCK_MUX_2, 0xC0));
    HPM_CHECK_RET(es8389_write_reg(control, ES8389_REG0x08_ADC_CLOCK_CONTROL, 0x00));
    HPM_CHECK_RET(es8389_write_reg(control, ES8389_REG0x09_DAC_CLOCK_CONTROL_1, 0xC0));
    HPM_CHECK_RET(es8389_write_reg(control, ES8389_REG0x0A_DAC_CLOCK_CONTROL_2, 0x80));

    HPM_CHECK_RET(es8389_write_reg(control, ES8389_REG0x0F_OSC_CLOCK_CONTROL, 0x10));
    HPM_CHECK_RET(es8389_write_reg(control, ES8389_REG0x21_ADC_OSR_CONTROL, 0x1F));
    HPM_CHECK_RET(es8389_write_reg(control, ES8389_REG0x22_ADC_DSP_COUNTER_CONTROL, 0x7F));
    HPM_CHECK_RET(es8389_write_reg(control, ES8389_REG0x2F_ADC_LRCK_SYNC_CONTROL, 0xC0));
    HPM_CHECK_RET(es8389_write_reg(control, EVEREST_REG0x30, 0xF4));
    HPM_CHECK_RET(es8389_write_reg(control, ES8389_REG0x31_ADC_RESET_CONTROL, 0x00 + (ES8389_MIX_DAC1AndADC1ToADC1 << 7) + (ES8389_MIX_DAC2AndADC2ToADC2 << 6)));
    HPM_CHECK_RET(es8389_write_reg(control, ES8389_REG0x44_DAC_MIX_CONTROL,
                                   0x00 + (ES8389_MIX_DAC1AndDAC2ToDAC1 << 3) + (ES8389_MIX_DAC1AndDAC2ToDAC2 << 2) + (ES8389_MIX_ADC1AndDAC1ToDAC1 << 1) +
                                   (ES8389_MIX_ADC2AndDAC2ToDAC2 << 0)));
    HPM_CHECK_RET(es8389_write_reg(control, ES8389_REG0x41_DAC_DSM_COUNTER_CONTROL, 0x7F));
    HPM_CHECK_RET(es8389_write_reg(control, ES8389_REG0x42_DAC_DSP_COUNTER_CONTROL, 0x7F));
    HPM_CHECK_RET(es8389_write_reg(control, ES8389_REG0x43_DAC_MISC_CONTROL_1, 0x10));
    HPM_CHECK_RET(es8389_write_reg(control, ES8389_REG0x49_DAC_VC_RAMP_CONTROL, 0x0F + (ES8389_DACSTDM_SLOTSel << 4)));
    HPM_CHECK_RET(es8389_write_reg(control, EVEREST_REG0x4C, 0xC0));

    HPM_CHECK_RET(es8389_write_reg(control, ES8389_REG0x00_RESET_CONTROL, 0x00));
    HPM_CHECK_RET(es8389_write_reg(control, ES8389_REG0x03_CLOCK_OFF1, 0xC1));
    HPM_CHECK_RET(es8389_write_reg(control, ES8389_REG0x00_RESET_CONTROL, 0x01));
    HPM_CHECK_RET(es8389_write_reg(control, ES8389_REG0x4D_DAC_RESET_CONTROL, 0x02));

    HPM_CHECK_RET(es8389_write_reg(control, ES8389_REG0x26_ADC_OSR_VOLUME_CONTROL, ES8389_ADC_DMICGainSel));
    HPM_CHECK_RET(es8389_write_reg(control, ES8389_REG0x27_ADC1_VOLUME_CONTROL, ES8389_ADC1_DigVolume));
    HPM_CHECK_RET(es8389_write_reg(control, ES8389_REG0x28_ADC2_VOLUME_CONTROL, ES8389_ADC2_DigVolume));
    HPM_CHECK_RET(es8389_write_reg(control, ES8389_REG0x46_DAC1_VOLUME_CONTROL, ES8389_DAC1_DigVolume));
    HPM_CHECK_RET(es8389_write_reg(control, ES8389_REG0x47_DAC2_VOLUME_CONTROL, ES8389_DAC2_DigVolume));
    HPM_CHECK_RET(es8389_write_reg(control, ES8389_REG0x48_MIX_VOLUME_CONTROL, (ES8389_ADC2DAC_MIX_Volume << 1)));

    /* set data format: sample rate and data width */
    HPM_CHECK_RET(es8389_set_data_format(control, config->mclk_hz, config->sample_rate, config->data_width));

    /* power on */
    HPM_CHECK_RET(es8389_enter_power_on(control));

    return stat;
}


hpm_stat_t es8389_config_clock(codec_control_t *control, uint32_t mclk, uint32_t sample_rate)
{
    hpm_stat_t stat = status_success;

    uint32_t ratio = (uint32_t)((float)(mclk) / (sample_rate) + 0.5f);

    int8_t coeff = get_coeff(mclk, ratio, sizeof(coeff_div) / sizeof(struct _coeff_div), coeff_div);
    if (coeff < 0) {
        return status_invalid_argument;
    }

    /* Calculate SCLK_DIV in master mode */
    uint8_t reg_val;
    es8389_read_reg(control, ES8389_REG0x01_MISC_CONTROL, &reg_val);
    if ((reg_val & ES8389_MISC_CONTROL_MS_MODE_MASK)) {
        uint16_t sclk_div = mclk / (sample_rate * 2 * 32); /* Assume 2 channels, 32 bits per channel */
        HPM_CHECK_RET(es8389_write_reg(control, ES8389_REG0x0B_MASTER_SCLK_DIVIDER, sclk_div));
    }

    /* configure LRCK divider */
    HPM_CHECK_RET(es8389_modify_reg(control, ES8389_REG0x0C_MASTER_LRCK_DIVIDER_1,
                                    ES8389_MASTER_LRCK_DIVIDER_1_MST_LRCK_DIVH_MASK, ES8389_MASTER_LRCK_DIVIDER_1_MST_LRCK_DIVH_SET(ratio >> 8)));
    HPM_CHECK_RET(es8389_write_reg(control, ES8389_REG0x0D_MASTER_LRCK_DIVIDER_2, ES8389_MASTER_LRCK_DIVIDER_2_MST_LRCK_DIVL_SET(ratio)));

    if (coeff >= 0) {
        HPM_CHECK_RET(es8389_write_reg(control, ES8389_REG0x04_MAIN_CLOCK_DIVIDER1, coeff_div[coeff].reg0x04));
        HPM_CHECK_RET(es8389_write_reg(control, ES8389_REG0x05_MASTER_CLOCK_MULTIPLICATION, coeff_div[coeff].reg0x05));
        HPM_CHECK_RET(es8389_write_reg(control, ES8389_REG0x06_MAIN_CLOCK_MUX1, coeff_div[coeff].reg0x06));
        HPM_CHECK_RET(es8389_write_reg(control, ES8389_REG0x07_MAIN_CLOCK_MUX_2, coeff_div[coeff].reg0x07));
        HPM_CHECK_RET(es8389_write_reg(control, ES8389_REG0x08_ADC_CLOCK_CONTROL, coeff_div[coeff].reg0x08));
        HPM_CHECK_RET(es8389_write_reg(control, ES8389_REG0x09_DAC_CLOCK_CONTROL_1, coeff_div[coeff].reg0x09));
        HPM_CHECK_RET(es8389_write_reg(control, ES8389_REG0x0A_DAC_CLOCK_CONTROL_2, coeff_div[coeff].reg0x0a));
        HPM_CHECK_RET(es8389_modify_reg(control, ES8389_REG0x0F_OSC_CLOCK_CONTROL, 0xC0, coeff_div[coeff].reg0x0f));
        HPM_CHECK_RET(es8389_write_reg(control, ES8389_REG0x11_MAIN_CLOCK_DIVIDER_2, coeff_div[coeff].reg0x11));
        HPM_CHECK_RET(es8389_write_reg(control, ES8389_REG0x21_ADC_OSR_CONTROL, coeff_div[coeff].reg0x21));
        HPM_CHECK_RET(es8389_write_reg(control, ES8389_REG0x22_ADC_DSP_COUNTER_CONTROL, coeff_div[coeff].reg0x22));
        HPM_CHECK_RET(es8389_write_reg(control, ES8389_REG0x26_ADC_OSR_VOLUME_CONTROL, coeff_div[coeff].reg0x26));
        HPM_CHECK_RET(es8389_modify_reg(control, EVEREST_REG0x30, 0xC0, coeff_div[coeff].reg0x30));
        HPM_CHECK_RET(es8389_write_reg(control, ES8389_REG0x41_DAC_DSM_COUNTER_CONTROL, coeff_div[coeff].reg0x41));
        HPM_CHECK_RET(es8389_write_reg(control, ES8389_REG0x42_DAC_DSP_COUNTER_CONTROL, coeff_div[coeff].reg0x42));
        HPM_CHECK_RET(es8389_modify_reg(control, ES8389_REG0x43_DAC_MISC_CONTROL_1, 0x81, coeff_div[coeff].reg0x43));
        HPM_CHECK_RET(es8389_modify_reg(control, ES8389_REG0xF0_CHIP_MISC_CONTROL, 0x73, coeff_div[coeff].reg0xf0));
        HPM_CHECK_RET(es8389_write_reg(control, ES8389_REG0xF1_CSM_STATE_REPORT, coeff_div[coeff].reg0xf1));
        HPM_CHECK_RET(es8389_write_reg(control, EVEREST_REG0x16, coeff_div[coeff].reg0x16));
        HPM_CHECK_RET(es8389_write_reg(control, EVEREST_REG0x18, coeff_div[coeff].reg0x18));
        HPM_CHECK_RET(es8389_write_reg(control, EVEREST_REG0x19, coeff_div[coeff].reg0x19));
    }

    return stat;
}

hpm_stat_t es8389_set_protocol(codec_control_t *control, es8389_protocol_t protocol, es8389_lrclk_polarity_t lrclk_polarity)
{
    hpm_stat_t stat = status_success;
    bool invert_lrck = false;
    switch (protocol) {
    case es8389_protocol_i2s:
        if (lrclk_polarity == es8389_lrclk_polarity_high_for_left_channel) {
            invert_lrck = true;
        } else {
            invert_lrck = false;
        }
        break;
    case es8389_protocol_left_justified:
        if (lrclk_polarity == es8389_lrclk_polarity_low_for_left_channel) {
            invert_lrck = true;
        } else {
            invert_lrck = false;
        }
        break;
    case es8389_protocol_pcma:
        invert_lrck = false;
        break;
    case es8389_protocol_pcmb:
        invert_lrck = true;
        break;
    default:
        invert_lrck = false;
        break;
    }

    HPM_CHECK_RET(es8389_modify_reg(control, ES8389_REG0x0C_MASTER_LRCK_DIVIDER_1, ES8389_MASTER_LRCK_DIVIDER_1_MST_SP_LRP_MASK,
                                    ES8389_MASTER_LRCK_DIVIDER_1_MST_SP_LRP_SET(invert_lrck)));
    HPM_CHECK_RET(es8389_modify_reg(control, ES8389_REG0x0C_MASTER_LRCK_DIVIDER_1, ES8389_MASTER_LRCK_DIVIDER_1_MST_SP_PTL_MASK,
                                    ES8389_MASTER_LRCK_DIVIDER_1_MST_SP_PTL_SET(protocol)));

    HPM_CHECK_RET(
        es8389_modify_reg(control, ES8389_REG0x20_ADC_SP_CONTROL, ES8389_ADC_SP_CONTROL_ADC_SP_LRP_MASK, ES8389_ADC_SP_CONTROL_ADC_SP_LRP_SET(invert_lrck)));
    HPM_CHECK_RET(
        es8389_modify_reg(control, ES8389_REG0x20_ADC_SP_CONTROL, ES8389_ADC_SP_CONTROL_ADC_SP_PTL_MASK, ES8389_ADC_SP_CONTROL_ADC_SP_PTL_SET(protocol)));

    HPM_CHECK_RET(es8389_modify_reg(control, ES8389_REG0x40_DAC_SERIAL_PORT_CONTROL, ES8389_DAC_SERIAL_PORT_CONTROL_DAC_SP_LRP_MASK,
                                    ES8389_DAC_SERIAL_PORT_CONTROL_DAC_SP_LRP_SET(invert_lrck)));
    HPM_CHECK_RET(es8389_modify_reg(control, ES8389_REG0x40_DAC_SERIAL_PORT_CONTROL, ES8389_DAC_SERIAL_PORT_CONTROL_DAC_SP_PTL_MASK,
                                    ES8389_DAC_SERIAL_PORT_CONTROL_DAC_SP_PTL_SET(protocol)));

    return stat;
}

hpm_stat_t es8389_set_data_width(codec_control_t *control, uint8_t data_width)
{
    hpm_stat_t stat = status_success;

    uint8_t val = 0;
    switch (data_width) {
    case 24:
        val = 0x0;
        break;
    case 20:
        val = 0x1;
        break;
    case 18:
        val = 0x2;
        break;
    case 16:
        val = 0x3;
        break;
    case 32:
        val = 0x4;
        break;
    default:
        return status_invalid_argument;
    }
    HPM_CHECK_RET(es8389_modify_reg(control, ES8389_REG0x20_ADC_SP_CONTROL, ES8389_ADC_SP_CONTROL_ADC_SP_WL_MASK, ES8389_ADC_SP_CONTROL_ADC_SP_WL_SET(val)));
    HPM_CHECK_RET(es8389_modify_reg(control, ES8389_REG0x40_DAC_SERIAL_PORT_CONTROL, ES8389_DAC_SERIAL_PORT_CONTROL_DAC_SP_WL_MASK,
                                    ES8389_DAC_SERIAL_PORT_CONTROL_DAC_SP_WL_SET(val)));
    return stat;
}

hpm_stat_t es8389_set_data_format(codec_control_t *control, uint32_t mclk, uint32_t sample_rate, uint8_t data_width)
{
    hpm_stat_t stat = status_success;

    HPM_CHECK_RET(es8389_config_clock(control, mclk, sample_rate));
    HPM_CHECK_RET(es8389_set_data_width(control, data_width));

    return stat;
}

/* Everest chip enters bias_on (power on) state */
hpm_stat_t es8389_enter_power_on(codec_control_t *control)
{
    hpm_stat_t stat = status_success;
    HPM_CHECK_RET(es8389_write_reg(control, ES8389_REG0x4D_DAC_RESET_CONTROL, 0x02));
    HPM_CHECK_RET(es8389_modify_reg(control, ES8389_REG0x69_DAC_ANALOG_CONTROL, 0x20, 0x20));
    HPM_CHECK_RET(es8389_write_reg(control, ES8389_REG0x61_ANALOG_ENABLE_CONTROL_1, 0xD9));
    HPM_CHECK_RET(es8389_write_reg(control, ES8389_REG0x64_ADC_ANALOG_ENABLE_CONTROL, 0x8F));
    HPM_CHECK_RET(es8389_write_reg(control, ES8389_REG0x10_CSM_JUMP_CONTROL, 0xE4));
    HPM_CHECK_RET(es8389_write_reg(control, ES8389_REG0x00_RESET_CONTROL, 0x01));
    HPM_CHECK_RET(es8389_write_reg(control, ES8389_REG0x03_CLOCK_OFF1, 0xC3));
    HPM_CHECK_RET(es8389_write_reg(control, ES8389_REG0x24_ADC_HPF_CONTROL_1, 0x6A));
    HPM_CHECK_RET(es8389_write_reg(control, ES8389_REG0x25_ADC_HPF_CONTROL_2, 0x0A + (ES8389_ADC1_Invert << 6) + (ES8389_ADC2_Invert << 5)));
    return stat;
}

/* Everest chip enters Standby state */
hpm_stat_t es8389_enter_standby(codec_control_t *control)
{
    hpm_stat_t stat = status_success;
    HPM_CHECK_RET(es8389_modify_reg(control, ES8389_REG0x40_DAC_SERIAL_PORT_CONTROL, 0x03, 0x03)); /* DAC MUTE, prevent large signal during STANDBY causing additional POP */
    HPM_CHECK_RET(es8389_write_reg(control, ES8389_REG0x10_CSM_JUMP_CONTROL, 0xD4));
    board_delay_ms(70);
    HPM_CHECK_RET(es8389_write_reg(control, ES8389_REG0x61_ANALOG_ENABLE_CONTROL_1, 0x59));
    HPM_CHECK_RET(es8389_write_reg(control, ES8389_REG0x64_ADC_ANALOG_ENABLE_CONTROL, 0x00));
    HPM_CHECK_RET(es8389_write_reg(control, ES8389_REG0x03_CLOCK_OFF1, 0x00));
    HPM_CHECK_RET(es8389_write_reg(control, ES8389_REG0x00_RESET_CONTROL, 0x7E));
    HPM_CHECK_RET(es8389_modify_reg(control, ES8389_REG0x40_DAC_SERIAL_PORT_CONTROL, 0x03, 0x00)); /* Release MUTE after closing */
    return stat;
}

/* Everest chip enters bias_off (power down) state */
hpm_stat_t es8389_enter_power_down(codec_control_t *control)
{
    hpm_stat_t stat = status_success;
    HPM_CHECK_RET(es8389_write_reg(control, ES8389_REG0x01_MISC_CONTROL, 0x28));
    HPM_CHECK_RET(es8389_modify_reg(control, ES8389_REG0x69_DAC_ANALOG_CONTROL, 0x20, 0x00));
    HPM_CHECK_RET(es8389_write_reg(control, ES8389_REG0x60_VMID_CONTROL, 0x00));
    HPM_CHECK_RET(es8389_write_reg(control, ES8389_REG0x00_RESET_CONTROL, 0x00));
    HPM_CHECK_RET(es8389_write_reg(control, ES8389_REG0x10_CSM_JUMP_CONTROL, 0xCC));
    board_delay_ms(500);
    HPM_CHECK_RET(es8389_write_reg(control, ES8389_REG0x10_CSM_JUMP_CONTROL, 0x00));
    HPM_CHECK_RET(es8389_write_reg(control, ES8389_REG0x61_ANALOG_ENABLE_CONTROL_1, 0x08));
    HPM_CHECK_RET(es8389_write_reg(control, ES8389_REG0xF3_ISOLATION_CONTROL, 0xC1));
    HPM_CHECK_RET(es8389_write_reg(control, ES8389_REG0xF2_PULL_DOWN_CONTROL, 0x00));
    return stat;
}

hpm_stat_t es8389_set_volume(codec_control_t *control, es8389_module_t module, uint8_t volume)
{
    hpm_stat_t stat = status_success;

    switch (module) {
    case es8389_adc1:
        HPM_CHECK_RET(es8389_write_reg(control, ES8389_REG0x27_ADC1_VOLUME_CONTROL, volume));
        break;
    case es8389_adc2:
        HPM_CHECK_RET(es8389_write_reg(control, ES8389_REG0x28_ADC2_VOLUME_CONTROL, volume));
        break;
    case es8389_dac1:
        HPM_CHECK_RET(es8389_write_reg(control, ES8389_REG0x46_DAC1_VOLUME_CONTROL, volume));
        break;
    case es8389_dac2:
        HPM_CHECK_RET(es8389_write_reg(control, ES8389_REG0x47_DAC2_VOLUME_CONTROL, volume));
        break;
    default:
        return status_invalid_argument;
    }

    return stat;
}

hpm_stat_t es8389_mute(codec_control_t *control, es8389_module_t module, bool mute)
{
    hpm_stat_t stat = status_success;

    switch (module) {
    case es8389_adc1:
        HPM_CHECK_RET(es8389_modify_reg(control, ES8389_REG0x20_ADC_SP_CONTROL, ES8389_ADC_SP_CONTROL_ADC1_P2S_SWMUTE_MASK, ES8389_ADC_SP_CONTROL_ADC1_P2S_SWMUTE_SET(mute)));
        break;
    case es8389_adc2:
        HPM_CHECK_RET(es8389_modify_reg(control, ES8389_REG0x20_ADC_SP_CONTROL, ES8389_ADC_SP_CONTROL_ADC2_P2S_SWMUTE_MASK, ES8389_ADC_SP_CONTROL_ADC2_P2S_SWMUTE_SET(mute)));
        break;
    case es8389_dac1:
        HPM_CHECK_RET(es8389_modify_reg(control, ES8389_REG0x40_DAC_SERIAL_PORT_CONTROL, ES8389_DAC_SERIAL_PORT_CONTROL_DAC1_S2P_SWMUTE_MASK, ES8389_DAC_SERIAL_PORT_CONTROL_DAC1_S2P_SWMUTE_SET(mute)));
        break;
    case es8389_dac2:
        HPM_CHECK_RET(es8389_modify_reg(control, ES8389_REG0x40_DAC_SERIAL_PORT_CONTROL, ES8389_DAC_SERIAL_PORT_CONTROL_DAC2_S2P_SWMUTE_MASK, ES8389_DAC_SERIAL_PORT_CONTROL_DAC2_S2P_SWMUTE_SET(mute)));
        break;
    default:
        return status_invalid_argument;
    }

    return stat;
}


